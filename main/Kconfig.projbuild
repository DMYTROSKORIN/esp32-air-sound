## main/Kconfig.projbuild
```kconfig
menu "esp32-air-sound"

    config AIRSOUND_TONE_ENABLE
        bool "Send a test tone instead of silence when nothing streams"
        default n
        help
            Bench aid: a 1 kHz tone gated 0.5 s on / 0.5 s off. Off in normal use.

    config AIRSOUND_TONE_DB
        int "Test tone level, dB below full scale"
        range 0 60
        default 20

    config AIRSOUND_LINE_TRIM_DB
        int "Output trim, dB below full scale, applied to everything"
        range 0 40
        default 18
        help
            The PCM5102 puts out 2.1 Vrms at full scale, the Si4713 line input is 636 mVpk at its
            most tolerant setting: 14 dB of trim lands full scale exactly at the transmitter's
            0 dBfs, and pre-emphasis then pushes bright peaks into its limiter. 18 dB leaves 4 dB
            of headroom, so the limiter stays out of the way of the music. Until a resistor
            divider sits in the aux path this trim is digital, applied in 32-bit arithmetic.

endmenu
```
